// SPDX-License-Identifier: (GPL-2.0+ OR BSD-3-Clause)
/*
 * Copyright (C) STMicroelectronics 2019 - All Rights Reserved
 * Author: Alexandre Torgue <alexandre.torgue@st.com> for STMicroelectronics.
 */

/dts-v1/;

/ {
	model = "Test Board for Raspberry Pi 4";
	compatible = "hl,pi4";

	#address-cells = <1>;
	#size-cells = <1>;

	serial@fe201000 {
		compatible = "hl,pl-uart";
		reg = <0xfe201000 0x1000>;
	};

	chosen {
		stdout-path = "/serial@fe201000";
	};
};
